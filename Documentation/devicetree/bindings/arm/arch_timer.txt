## Documentation/devicetree/bindings/arm/arch_timer.txt
```
* ARM architected timer

ARM cores may have a per-core architected timer, which provides per-cpu timers.

The timer is attached to a GIC to deliver its per-processor interrupts.

** Timer node properties:

- compatible : Should at least contain one of
	"arm,armv7-timer"
	"arm,armv8-timer"

- interrupts : Interrupt list for secure, non-secure, virtual and
  hypervisor timers, in that order.

- clock-frequency : The frequency of the main counter, in Hz. Optional.

- always-on : a boolean property. If present, the timer is powered through an
  always-on power domain, therefore it never loses context.

Example:

	timer {
		compatible = "arm,cortex-a15-timer",
			     "arm,armv7-timer";
		interrupts = <1 13 0xf08>,
			     <1 14 0xf08>,
			     <1 11 0xf08>,
			     <1 10 0xf08>;
		clock-frequency = <100000000>;
	};
```

## Documentation/devicetree/bindings/sound/imx-audio-ak4373.txt
```
Freescale i.MX audio complex with AK4373 DAC

Same as Simple-Card, specifies audio DAI connection of SoC <-> codec.

Required properties:

- compatible				: "fsl,imx-audio-ak4373"

Optional properties:

- imx-audio-ak4373,format		: CPU/CODEC common audio format.
					"i2s", "right_j", "left_j" , "dsp_a"
					"dsp_b", "ac97", "pdm", "msb", "lsb"
- model				: Name of audio card

Required subnodes:

- mux-int-port				: The internal port of the i.MX audio muxer (AUDMUX)
- mux-ext-port				: The external port of the i.MX audio muxer

Note:
 * The AUDMUX port numbering should start at 1, which is consistent with
hardware manual.

- cpu					: CPU   sub-node
- codec				: CODEC sub-node

Required CPU/CODEC subnodes properties:

- sound-dai				: phandle and port of CPU/CODEC

Optional CPU/CODEC subnodes properties:

- format				: CPU/CODEC specific audio format if needed.
					  see imx-audio-ak4373,format
- frame-master				: bool property. add this if subnode is frame master
- bitclock-master			: bool property. add this if subnode is bitclock master
- bitclock-inversion			: bool property. add this if subnode has clock inversion
- frame-inversion			: bool property. add this if subnode has frame inversion
- clocks / system-clock-frequency	: specify subnode's clock if needed.
					  it can be specified via "clocks" if system has
					  clock node (= common clock), or "system-clock-frequency"
					  (if system doens't support common clock)
Note:
 * For 'format', 'frame-master', 'bitclock-master', 'bitclock-inversion' and
   'frame-inversion', the simple card will use the settings of CODEC for both
   CPU and CODEC sides as we need to keep the settings identical for both ends
   of the link.

Example:

sound {
	compatible = "fsl,imx-audio-ak4373";
	model = "ak4373-audio";
	imx-audio-ak4373,format = "i2s";
	mux-int-port = <2>; /* AUDMUX internal port */
	mux-ext-port = <4>; /* AUDMUX external port */
	cpu {
		sound-dai = <&ssi2 2>;
		bitclock-master;
		frame-master;
		format = "i2s";
	};
	codec {
		sound-dai = <&ak4373>;
		format = "i2s";
	};
};

&i2c3 {
	ak4373: ak4373@12 {
		compatible = "asahi-kasei,ak4373";
		#sound-dai-cells = <0>;
		reg = <0x12>;
	};
};

ssi2: ssi@0202c000 {
	compatible = "fsl,imx6q-ssi","fsl,imx21-ssi";
	reg = <0x0202c000 0x4000>;
	interrupts = <0 47 0x04>;
	clocks = <&clks 179>, <&clks 158>;
	clock-names = "ipg", "baud";
	dmas = <&sdma 41 1 0>,
	       <&sdma 42 1 0>;
	dma-names = "rx", "tx";
	#sound-dai-cells = <0>;
	fsl,mode = "i2s-master";
	fsl,fifo-depth = <15>;
	status = "okay";
};
```

## arch/arm/Kconfig.snsc
```kconfig
#
# SNSC related configurations
#
config SNSC_ARM_REDUCE_ICACHE_INVALIDATION
       bool "Reduce I-cache invalidation on ARM v6 and later"
       depends on SNSC
       depends on CPU_CACHE_V6 || CPU_CACHE_V7
       default n
```

## drivers/base/power/Kconfig.snsc
```kconfig
#
# SNSC related configurations
#
config SNSC_OPP_SUPPORT_ALT_OPP_TABLE
       bool
       depends on SNSC
       depends on PM_OPP
       default n
```

## drivers/bootconstraint/Kconfig
```kconfig
config DEV_BOOT_CONSTRAINT
	bool "Boot constraints for devices"
	help
	  This enables boot constraints detection for devices. These constraints
	  are (normally) set by the Bootloader and must be satisfied by the
	  kernel until the relevant device driver is probed. Once the driver is
	  probed, the constraint is dropped.

	  If unsure, say N.
```

## drivers/char/hifc/Kconfig
```kconfig
#
# CXD5602 HostIFC device configuration
#

menu 'CXD5602 HostIFC Driver'
config HIFC_DRIVER
	tristate 'CXD5602 HostIFC protocol message dispatch handler'
	default y
	---help---
		If you say Y here and create a character special device named hifc-i2c,
		you can read or write data from/to CXD5602 HAPs through it.
		Generally it connets the CXD5602 HAPs through I2C or SPI.
		Consequentl you should config the low level drivers.

choice
	prompt "Select HostIFC low level drivers interface"
	default HIFC_DRVIF_SPI
	depends on HIFC_DRIVER

config HIFC_DRVIF_I2C
	bool 'I2C Driver'
	depends on I2C
	---help---
		Use the I2C as the low level driver interface.

config HIFC_DRVIF_SPI
	bool 'SPI Driver'
	depends on SPI_MASTER
	---help---
		Use the SPI as the low level driver interface.

endchoice

config HIFC_ICMD_DEBUG
	bool "HostIFC ICMD debug"
	default n
	---help---
		Say Y here will enable the ICMD hex byte dump, it might helpful if you
		want to see the actual contents of ICMD transmission. You might say N
		if you do not care what ICMD is.
endmenu
```

## drivers/hss/test/Kconfig
```kconfig
#
# HSS test configuration
#
config SNSC_HSS_TEST
	tristate "HSS test driver"
	depends on SNSC_HSS
	---help---
	  test driver for HSS
```

## drivers/mmc/Kconfig.snsc
```kconfig
config SNSC_MMC_FIX_MINOR_NUMBER
	bool "MMC fix minor number"
	depends on MMC && MMC_BLOCK
	default y

config SNSC_MMC_BKOPS_ENABLE_IOCTL
	bool "MMC BKOPS enable ioctl"
	depends on MMC && MMC_BLOCK
	default y
```

## drivers/platform/Kconfig
```kconfig
if X86
source "drivers/platform/x86/Kconfig"
endif
if GOLDFISH
source "drivers/platform/goldfish/Kconfig"
endif
if ARCH_VXR10
source "drivers/platform/vxr10/Kconfig"
endif
```

## drivers/soc/hisilicon/Kconfig
```kconfig
#
# Hisilicon Soc drivers
#

menu "Hisilicon SoC drivers"

config HISI_BOOT_CONSTRAINT
	bool "Hisilicon Boot Constraints"
	depends on ARCH_HISI
	select DEV_BOOT_CONSTRAINT
	default y
	help
	  Say y here to enable Boot Constraints on Hisilicon platforms.

endmenu
```

## drivers/soc/imx/Kconfig
```kconfig
menu "i.MX SoC drivers"

config IMX7_PM_DOMAINS
	bool "i.MX7 PM domains"
	depends on SOC_IMX7D || (COMPILE_TEST && OF)
	depends on PM
	select PM_GENERIC_DOMAINS
	default y if SOC_IMX7D

config IMX_BOOT_CONSTRAINT
	bool "i.MX Boot Constraints"
	depends on ARCH_MXC
	select DEV_BOOT_CONSTRAINT
	default y
	help
	  Say y here to enable Boot Constraints on i.MX platforms.

endmenu
```

## drivers/usb/dwc3/Kconfig
```kconfig
config USB_DWC3
	tristate "DesignWare USB3 DRD Core Support"
	depends on (USB || USB_GADGET) && GENERIC_HARDIRQS
	select USB_XHCI_PLATFORM if USB_SUPPORT && USB_XHCI_HCD
	help
	  Say Y or M here if your system has a Dual Role SuperSpeed
	  USB controller based on the DesignWare USB3 IP Core.

	  If you choose to build this driver is a dynamically linked
	  module, the module will be called dwc3.ko.

if USB_DWC3

choice
	bool "DWC3 Mode Selection"
	default USB_DWC3_DUAL_ROLE if (USB && USB_GADGET)
	default USB_DWC3_HOST if (USB && !USB_GADGET)
	default USB_DWC3_GADGET if (!USB && USB_GADGET)

config USB_DWC3_HOST
	bool "Host only mode"
	depends on USB=y || USB=USB_DWC3
	help
	  Select this when you want to use DWC3 in host mode only,
	  thereby the gadget feature will be regressed.

config USB_DWC3_GADGET
	bool "Gadget only mode"
	depends on USB_GADGET=y || USB_GADGET=USB_DWC3
	help
	  Select this when you want to use DWC3 in gadget mode only,
	  thereby the host feature will be regressed.

config USB_DWC3_DUAL_ROLE
	bool "Dual Role mode"
	depends on ((USB=y || USB=USB_DWC3) && (USB_GADGET=y || USB_GADGET=USB_DWC3))
	help
	  This is the default mode of working of DWC3 controller where
	  both host and gadget features are enabled.

config USB_DWC3_VXR10_MODE
	bool "VXR10 mode"
	depends on ARCH_VXR10
	help
	  Select this when you want to use USB Host/Device on VXR10.

endchoice

comment "Platform Glue Driver Support"

config USB_DWC3_VXR10_USBH
	tristate "Sony VXR10 Platform Host Driver"
	depends on USB_DWC3_VXR10_MODE
        help
          Use USB2.0 Host on VXR10

config USB_DWC3_VXR10_USBD
	tristate "Sony VXR10 Platform Device Driver"
	depends on USB_DWC3_VXR10_MODE && USB_GADGET
        help
          Use USB3.0/2.0 Device on VXR10

comment "Debugging features"

config USB_DWC3_DEBUG
	bool "Enable Debugging Messages"
	help
	  Say Y here to enable debugging messages on DWC3 Driver.

config USB_DWC3_VERBOSE
	bool "Enable Verbose Debugging Messages"
	depends on USB_DWC3_DEBUG
	help
	  Say Y here to enable verbose debugging messages on DWC3 Driver.

endif
```

## init/Kconfig.snsc
```kconfig
#
# SNSC related configurations
#

config SNSC_NLVER_CUSTOMVER_ENABLE
       bool 'Use custom kernel version'
       depends on SNSC

config SNSC_NLVER_CUSTOMVER
       string 'Custom kernel version'
       depends on SNSC_NLVER_CUSTOMVER_ENABLE
       depends on SNSC

config SNSC_NLVER_REPOSITORYVERSION_AUTO
       bool 'Embed git/arch repository revision'
       depends on SNSC

config SNSC_SERIAL_DEMOLISH
       bool "Support for DEMOLISH console"
       depends on SNSC
       depends on SERIAL_8250
       depends on !ARCH_MP200
       default y
```

## kernel/Kconfig.snsc
```kconfig
#
# SNSC related configurations
#

config SNSC_SET_THREAD_PRIORITY
	bool
	depends on SNSC
	default n

config SNSC_KTHREAD_INHERIT_CPU_AFFINITY
	bool "Make kernel threads inherit CPU affinity"
	depends on SNSC
	default n
	help
	  CPU affinity of kernel threads are not inherited by default.
	  If you enable this option, they inherit kthreadd's affinity.

config SNSC_SHIELD_KTHREADD
	bool "Allow kthreadd to be moved to non-root group"
	depends on SNSC && SNSC_KTHREAD_INHERIT_CPU_AFFINITY
	default n
	help
	  kthreadd is not allowed to non-root group by default and cannot be
	  shielded. If you enable this option, restriction on disallow
	  attaching kthreadd is removed and kthreadd can be shielded.

config SNSC_ALLOW_SET_AFFINITY_TO_UNBOUND_WQ
	bool "Allow setting affinity to unbound workqueues"
	depends on SNSC
	default n
	help
	  Usually you cannot set affinity to unbound workqueues.
	  This option eliminates the restriction.

config SNSC_POSIX_CLOCK_SNSC_RAW_CLOCK
	bool "POSIX clock support for snsc_raw_clock()"
	depends on SNSC
	default n
	help
	  This option enables special POSIX clock to be able to get a value
	  of snsc_raw_clock() from user space by clock_gettime() with special
	  clock ID (CLOCK_SNSC_RAW_CLOCK).
	  Note: CLOCK_SNSC_RAW_CLOCK is non-compliant with POSIX specification.
```

## kernel/power/ssboot/Kconfig
```kconfig
#
# Snapshot Boot related configurations
#

menuconfig SNSC_SSBOOT
	bool "Snapshot Boot support"
	depends on !HIBERNATION
	depends on SNSC
	default n
	select SUSPEND

config SNSC_SSBOOT_DEBUG
	bool "Snapshot Boot debugging support"
	depends on SNSC_SSBOOT
	default n

config SNSC_SSBOOT_DEBUG_SECTION
	bool "Show section information"
	depends on SNSC_SSBOOT_DEBUG
	default n

config SNSC_SSBOOT_PAGE_STAT
	bool "Show page statistics information"
	depends on SNSC_SSBOOT
	default y

config SNSC_SSBOOT_NO_KERNEL
	bool "Exclude kernel R/O sections"
	depends on SNSC_SSBOOT
	default n

config SNSC_SSBOOT_DETECT_ZERO_PAGES
	bool "Find zero cleared pages"
	depends on SNSC_SSBOOT
	default n

config SNSC_SSBOOT_PAGE_ATTR_DUMP
	tristate "Page Attr Dump Writer support"
	depends on SNSC_SSBOOT
	default n

config SNSC_SSBOOT_PAGE_ATTR_DUMP_FILE_NAME
	string "Page Attr Dump Writer filename"
	depends on SNSC_SSBOOT_PAGE_ATTR_DUMP
	default "/tmp/page_attr_dump.txt"

config SNSC_SSBOOT_IMGVER
	bool "Embed version information into images"
	depends on SNSC_SSBOOT
	default n

config SNSC_SSBOOT_SBI
	tristate "SBI writer support"
	depends on SNSC_SSBOOT
	default y

config SNSC_SSBOOT_SBI_FILE
	tristate "Generic SBI file writer"
	depends on SNSC_SSBOOT_SBI
	default y

config SNSC_SSBOOT_SBI_FILE_NAME
	string "Default SBI filename"
	depends on SNSC_SSBOOT_SBI_FILE
	default "/ssboot.sbi"

config SNSC_SSBOOT_SBI_SECTION_ENCRYPTION
        bool "SBI section encryption"
        depends on SNSC_SSBOOT_SBI
        default n

config SNSC_SSBOOT_SBI_DECRYPTION_SELF_TEST
	bool "SBI section decryption self test"
	depends on SNSC_SSBOOT_SBI_SECTION_ENCRYPTION
	default n

config SNSC_SSBOOT_SBI_CKSUM
	bool "Add checksum to SBI images"
	depends on SNSC_SSBOOT
	default n
```

## lib/Kconfig.debug_snsc
```kconfig
menu "SNSC Configurations"

comment "SNSC debug options"
	depends on SNSC

config EXCEPTION_MONITOR
	bool "Exception Monitor support"
	depends on ARM || X86
	default n
	help
	  This option will activate Exception Monitor hook.
	  Exception Monitor is diagnostic/analyze tool when exception occurs.
	  You will also need exception_monitor.ko and insmod it to work.

config EXCEPTION_MONITOR_STOP_SIBLING_TIMEOUT
	int "Timeout(msec) of Exception Monitor waiting for threads to stop"
	depends on EXCEPTION_MONITOR
	default "7000"
	help
	  When Exception Monitor is invoked by user-mode failure, EM
	  sends SIGSTOP to threads in the same address space and waits
	  for them to stop.  This value specifies timeout (in msec)
	  used when waiting for threads in uninterruptible state.  A
	  negative value means waiting without timeout.

config EXCEPTION_MONITOR_GIVE_UP_WAITING_FOR_THREADS_TO_STOP
	bool "Give up waiting for threads to stop"
	depends on EXCEPTION_MONITOR
	default y
	help
	  When Exception Monitor is invoked by user-mode failure, EM
	  sends SIGSTOP to threads in the same address space and waits
	  for them to stop. But in a situation, some threads can't
	  stop because of its scheduling priority, then this prevent
	  Exception Monitor invoking. If this is enabled, Exception
	  Monitor will give up to wait the threads to stop with
	  timeout specified by EXCEPTION_MONITOR_STOP_SIBLING_TIMEOUT.
	  Note that threads in uninterruptible state are always given
	  up, even if this is disabled.

config CONSOLE_READ
	bool "Read input from console"
	depends on EXCEPTION_MONITOR
	default y
	help
	  Read input from console part split from exception monitor.

config EXCEPTION_MONITOR_ON_PANIC
	bool "Invoke Exception Monitor on panic"
	depends on EXCEPTION_MONITOR
	default n
	help
	  If y, panic() invokes Exception Monitor.

source "tools/em/Kconfig.snsc"

config SNSC_ALT_BACKTRACE
	bool  'Enable alternative backtrace routine'
	depends on SNSC
	depends on (!ARM || ARM_UNWIND_USER)
	default y

config SNSC_ALT_BACKTRACE_PROC_USTACK
	bool  'Proc entry for human-readable user-stack backtrace'
	depends on SNSC_ALT_BACKTRACE
	default y
	help
	   This option creates /proc/TGID/task/PID/ustack.  'cat' it
	   to print backtrace of userspace stack of the specified
	   task.  During backtracing, the task is stopped by ptrace.
	   Another entry /proc/TGID/task/PID/ustack_raw does not stop
	   the task but reading it while the task is running may
	   return meaningless results.

endmenu
```
